VERSION "0.2.0"

NS_ :

BS_:

BU_: SyntheticEngineEcu SyntheticCcu

BO_ 384 EngineStatus: 1 SyntheticEngineEcu
 SG_ IgnitionOn : 0|1@1+ (1,0) [0|1] "" SyntheticCcu
 SG_ EngineRunning : 1|1@1+ (1,0) [0|1] "" SyntheticCcu

BO_ 385 VehicleSpeed: 2 SyntheticEngineEcu
 SG_ VehicleSpeedKph : 7|16@0+ (0.1,0) [0|6553.5] "km/h" SyntheticCcu

CM_ "Completely fictional portfolio-safe CAN model for the validation platform.";
CM_ BO_ 384 "Synthetic ignition and engine-running state.";
CM_ BO_ 385 "Synthetic vehicle speed.";
